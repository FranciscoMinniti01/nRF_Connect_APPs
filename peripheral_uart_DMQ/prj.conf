## CMakeLists.txt
```
#
# Copyright (c) 2018 Nordic Semiconductor
#
# SPDX-License-Identifier: LicenseRef-Nordic-5-Clause
#
cmake_minimum_required(VERSION 3.20.0)

find_package(Zephyr REQUIRED HINTS $ENV{ZEPHYR_BASE})
project(peripheral_uart_DMQ)

FILE(GLOB app_sources src/*.c)

# Incluir el directorio src para que pueda encontrar los archivos .h
target_include_directories(app PRIVATE src)

target_sources(app PRIVATE ${app_sources})
```

## prj.conf
```kconfig
# Enable the UART driver
CONFIG_UART_ASYNC_API=y
CONFIG_NRFX_UARTE0=y
#CONFIG_SERIAL=y                # Definido en ubx_bmd340eval    # Habilitar opciones para el serial drivers.

#CONFIG_GPIO=y                  # Definido en ubx_bmd340eval    # Incluir controladores GPIO en la configuración del sistema

# Make sure printk is printing to the UART console
#CONFIG_CONSOLE=y               # Definido en ubx_bmd340eval
#CONFIG_UART_CONSOLE=y          # Definido en ubx_bmd340eval

CONFIG_HEAP_MEM_POOL_SIZE=2048

CONFIG_BT=y                                                     # Habilita la pila de BLE y un conjunto de configuraciones predeterminadas
CONFIG_BT_PERIPHERAL=y                                          # Habilita el soporte para el rol de BLE periferico
CONFIG_BT_DEVICE_NAME="Nordic_UART_Service"                     # Nombre del dispositivo BLE (Nombre que ve el usuario)
CONFIG_BT_MAX_CONN=1                                            # Número máximo de conexiones Bluetooth simultáneas admitidas.
CONFIG_BT_MAX_PAIRED=1                                          # Número máximo de dispositivos Bluetooth emparejados. El número mínimo (y predeterminado) es 1.

#CONFIG_BT_NUS=n                                                # Habilita los archivos nus.c y nus.h. En ellos se declara el servicio y se agrega NUS a la tabla de atributos de la aplicación.
CONFIG_BT_GAP_AUTO_UPDATE_CONN_PARAMS=n                         # Desactva el envio automático de las solicitudes de actualizaciones de parámetros de conexión, se hace manualmente.
CONFIG_BT_USER_PHY_UPDATE=y


# Enable bonding
CONFIG_BT_SMP=y                                                 # Habilita el Protocolo de administración de seguridad a la pila de BLE. Esta inclucion permite y realiza el emparejamiento entre dispositivos
CONFIG_BT_FIXED_PASSKEY=y                                       # Con esta opción habilitada, la aplicación podrá llamar a la API bt_passkey_set() para establecer una clave de acceso fija. Si está habilitada, se llamará a la devolución de llamada pairing_confirm() para todos los emparejamientos entrantes.
CONFIG_SETTINGS=y                                               # Dependencia necesaria de CONFIG_BT_SETTINGS
CONFIG_BT_SETTINGS=y                                            # Cuando se habilita, la pila de Bluetooth se encargará de almacenar (y restaurar) el estado de Bluetooth (por ejemplo, las claves de emparejamiento) y la configuración de forma persistente en la memoria flash.
CONFIG_FLASH=y                                                  # Dependencia necesaria de CONFIG_BT_SETTINGS                                             
CONFIG_FLASH_PAGE_LAYOUT=y                                      # Dependencia necesaria de CONFIG_BT_SETTINGS
CONFIG_FLASH_MAP=y                                              # Dependencia necesaria de CONFIG_BT_SETTINGS
CONFIG_NVS=y                                                    # Dependencia necesaria de CONFIG_BT_SETTINGS

# Enable DK LED and Buttons library
CONFIG_DK_LIBRARY=y

# This example requires more stack
CONFIG_MAIN_STACK_SIZE=1152
CONFIG_SYSTEM_WORKQUEUE_STACK_SIZE=2048

# Config logger
CONFIG_LOG=y
CONFIG_LOG_DEFAULT_LEVEL=3
#CONFIG_USE_SEGGER_RTT=y        # Definido en ubx_bmd340eval
#CONFIG_LOG_BACKEND_RTT=y       # Definido en ubx_bmd340eval
CONFIG_LOG_BACKEND_UART=n
CONFIG_LOG_PRINTK=n
CONFIG_FPU=y                                                    # Permite que log pueda procesar numeros flotantes

CONFIG_ASSERT=y
```

## src/main.c
```c
// INCLUDES ------------------------------------------------------------------------------------------------------------------------

#include <zephyr/usb/usb_device.h>
#include <zephyr/device.h>
#include <zephyr/devicetree.h>
#include <soc.h>
#include <zephyr/bluetooth/hci.h>

#include <dk_buttons_and_leds.h>

#include "dmq_nus_service.h"                    // Incluye las funciones y definiciones particulares del servicio NUS utilizando el codigo modificado
#include "app_config.h"
#include "uart_machine.h"
#include "ble_machine.h"

// DEFINITIONS ------------------------------------------------------------------------------------------------------------------------

#define RUN_LED_BLINK_INTERVAL 	1000
#define RUN_STATUS_LED 			DK_LED1
#define CON_STATUS_LED 			DK_LED2

#define BUFFER_LEN 				6

// VARIABLES ------------------------------------------------------------------------------------------------------------------------

LOG_MODULE_REGISTER(LOG_MAIN,LOG_MAIN_LEVEL);			                // Registro del modulo logger y configuracion del nivel

enum app_machine
{
    APP_GET_UART,
    APP_SENT_BLE,
	APP_WAIT_BLE
};

static int8_t app_machine = APP_GET_UART;

static uint8_t buffer[BUFFER_LEN];

bool is_nus_send = true;
bool nus_send_status;

// NUS FUNCTIONS ------------------------------------------------------------------------------------------------------------------------

static void bt_receive_cb(struct bt_conn *conn, const uint8_t *const data, uint16_t len)
{
	LOG_INF("RX: %s",data);
}

void sent_cb(struct bt_conn *conn) { is_nus_send = true; }

void send_enabled_cb(bool status) { nus_send_status = status; }

nus_cb_t nus_cb = {
	.received = bt_receive_cb,
	.sent = sent_cb,
	.send_enabled = send_enabled_cb
};

// MAIN FUNCTIONS ------------------------------------------------------------------------------------------------------------------------

int main(void)
{
	static uint8_t data_len;
	uint8_t caracter;
	int blink_status = 0;
	int err = 0;

	LOG_INF("\r\n\n\n\nMAIN: Starting Bluetooth Peripheral UART\n");

	if (dk_leds_init()) {
		LOG_ERR("Cannot init LEDs (err: %d)", err);
		return 0;
	}

	if (bt_nus_init(&nus_cb)) {
		LOG_ERR("Failed to initialize UART service (err: %d)", err);
		return 0;
	}

	for (;;)
	{
		ble_machine();

		uart_machine();

		switch (app_machine)
		{
			case APP_GET_UART:
				caracter = get_rdy_data();
				while (caracter != 0) {
					buffer[data_len] = caracter;
					data_len++;
					if(data_len == BUFFER_LEN) {
						caracter = 0;
						app_machine = APP_SENT_BLE;
					} else {
						caracter = get_rdy_data();
					}
				}
				break;

			case APP_SENT_BLE:
				if(get_BLE_state_conn()) {
					if(!bt_nus_send(NULL,buffer,data_len)) {
						is_nus_send = false;
						app_machine = APP_WAIT_BLE;
						data_len 	= 0;
					}
				}
				break;

			case APP_WAIT_BLE:
				if(is_nus_send) app_machine = APP_GET_UART;
				else if(!get_BLE_state_conn()) is_nus_send = true;
				break;
		}

		if(!is_nus_send) dk_set_led(CON_STATUS_LED, (++blink_status) % 2);
		else if(get_BLE_state_conn()) dk_set_led(CON_STATUS_LED, 1);
		else dk_set_led(CON_STATUS_LED, 0);

		dk_set_led(RUN_STATUS_LED, (++blink_status) % 2);
		k_sleep(K_MSEC(RUN_LED_BLINK_INTERVAL));
	}
}

// ------------------------------------------------------------------------------------------------------------------------
```

## src/app_config.h
```c
#ifndef APP_CONFIG_H
#define APP_CONFIG_H

// INCLUDES ------------------------------------------------------------------------------------------------------------------------

#include <stdio.h>
#include <stddef.h>
#include <string.h>
#include <zephyr/types.h>
#include <zephyr/kernel.h>

#include <zephyr/logging/log.h>

// APP CONFIG ------------------------------------------------------------------------------------------------------------------------

// LOG_ERR 1 - LOG_WRN 2 - LOG_INF 3 - LOG_DBG 4
#define LOG_MAIN_LEVEL      3
#define LOG_BLE_LEVEL       3
#define LOG_UART_LEVEL      3
#define LOG_NUS_LEVEL       3

// BLE CONFIG ------------------------------------------------------------------------------------------------------------------------

// ADVERTISING
#define ADV_OPTIONS         BT_LE_ADV_OPT_CONNECTABLE      // Configuramos la publicidad como conectable
#define ADV_MIN_INTERVAL    BT_GAP_ADV_FAST_INT_MIN_2      // Configuramos el minimo intervalo de publicidad
#define ADV_MAX_INTERVAL    BT_GAP_ADV_FAST_INT_MAX_2      // Configuramos el maximo intervalo de publicidad
#define ADV_ADDR_DIREC      NULL                            // address of peer for directed advertising
// ADVERTISING PACKET
#define ADV_FLAGS           BT_LE_AD_GENERAL | BT_LE_AD_NO_BREDR      // Publicidad conectable disponible durante un período de tiempo prolongado y no compatible con bluetooth clasico
#define DEVICE_NAME         CONFIG_BT_DEVICE_NAME  
#define ADV_UUID_SERVICE    BT_UUID_NUS_VAL

// CONNECTION
#define CONN_MIN_INTERVAL   800
#define CONN_MAN_INTERVAL   800
#define CONN_LATENCY        10
#define CONN_TIMEOUT        400

// SECURITY
#define DEVICE_CODE         555555
#define PASSKEY             DEVICE_CODE

// NUS CONFIG ------------------------------------------------------------------------------------------------------------------------



// UART CONFIG ------------------------------------------------------------------------------------------------------------------------

#include <zephyr/drivers/uart.h>

#define UART_BAUDRATE           9600
#define UART_PARITY             UART_CFG_PARITY_NONE
#define UART_STOP_BITS          UART_CFG_STOP_BITS_1
#define UART_DATA_BITS          UART_CFG_DATA_BITS_8
#define UART_FLOW_CTRL          UART_CFG_FLOW_CTRL_NONE

#define RECEIVE_BUFF_SIZE 	    8
#define RECEIVE_BUFF_NUMBER     32
#define RECEIVE_TIMEOUT_HAR_US  10000000

#define CODE                    "DMQ"
#define LEN_CODE                3

// ------------------------------------------------------------------------------------------------------------------------

#endif//APP_CONFIG_H
```

## src/ble_machine.c
```c
// INCLUDES ------------------------------------------------------------------------------------------------------------------------

#include "ble_machine.h"

// VARIABLES ------------------------------------------------------------------------------------------------------------------------

LOG_MODULE_REGISTER(LOG_BLE,LOG_BLE_LEVEL);			            // Registro del modulo logger y configuracion del nivel

static uint8_t ble_machine_state    = BLE_CB_REGISTERS;	        // Estado de la maquina de estado BLE

static bool app_notifi_error        = false;                    // Indicador de error en la maquina de estado
static bool app_notifi_adv          = false;                    // Indicador de estado de advertising
static bool app_notifi_conn      = false;                    // Indicador del estado de la coneccion
static bool is_update_param         = false;
static bool is_update_PHY           = false;

struct bt_conn *current_conn        = NULL;

// ADVERTISING ------------------------------------------------------------------------------------------------------------------------

static const struct bt_data ad[] = {                                            // Estructura del Advertising package con la informacion que contiene
	BT_DATA_BYTES( BT_DATA_FLAGS, ADV_FLAGS),                                   // Configuracion de las banderas del paquete
	BT_DATA(BT_DATA_NAME_COMPLETE, DEVICE_NAME, sizeof(DEVICE_NAME) - 1),       // Incluye en el paquete el nombre del dispositivo que vera el usuario
};

static const struct bt_data sd[] = {                                            // Estructura del scan packet con la informacion que contiene
	BT_DATA_BYTES(BT_DATA_UUID128_ALL, ADV_UUID_SERVICE),                       // Incluye el UUID del servicio NUS
};

void advertising_start()
{
    int err;
	struct bt_le_adv_param *adv_param = BT_LE_ADV_PARAM( ADV_OPTIONS,           // Configuracion de la publicidad
                                                         ADV_MIN_INTERVAL,      // Configuracion del minimo intervalo de publicidad
                                                         ADV_MAX_INTERVAL,      // Configuracion del maximo intervalo de publicidad
                                                         ADV_ADDR_DIREC);       // Configuracion de la direcion BLE para publicidad dirigida

	err = bt_le_adv_start(adv_param, ad, ARRAY_SIZE(ad), sd, ARRAY_SIZE(sd));	// Inicio de la publicidad
	if (err) {
		if (err == -EALREADY) LOG_INF("Advertising continued\n");               // Esto nose si es necesario, lo dejo para ver cuando pasa, Tengo que probar con BT_LE_ADV_OPT_ONE_TIME en eñ adv_param. FRAN
		else LOG_ERR("Advertising failed to start. Error: %d\n", err);
		return;
	}

	app_notifi_adv = true;
	LOG_INF("Advertising successfully started\n");
}

// CONNECTIONS ------------------------------------------------------------------------------------------------------------------------

void connected(struct bt_conn *conn, uint8_t err)
{
    if (err) {
        LOG_ERR("Connection failed. Error: %d\n", err);
        return;
    }

    if(BT_ID_DEFAULT){}

    char addr[BT_ADDR_LE_STR_LEN];
    bt_addr_le_to_str(bt_conn_get_dst(conn), addr, sizeof(addr));
	LOG_INF("Connected %s", addr);

    struct bt_conn_info info;
	err = bt_conn_get_info(conn, &info);                                        // Optengo e imprimo los parametros iniciales de coneccion
	if (err) LOG_WRN("Get param of connection failed. Error: %d\n", err);
    else LOG_INF("Connection param: interval %.2f ms, latency %d intervals, timeout %d ms", info.le.interval*1.25, info.le.latency, info.le.timeout*10);
    
    current_conn = bt_conn_ref(conn);

    app_notifi_conn = true;
    ble_machine_state = BLE_UPDATE_CONN_PARAM;
}

void disconnected(struct bt_conn *conn, uint8_t reason)
{
    LOG_INF("Disconnected. Reason: %d\n", reason);
    app_notifi_conn = false;

    if (current_conn) {
		bt_conn_unref(current_conn);
		current_conn = NULL;
	}

    ble_machine_state = BLE_ADVERTISING;
}

void param_updated(struct bt_conn *conn, uint16_t interval, uint16_t latency, uint16_t timeout)
{
    LOG_INF("Conn param update: interval %.2f ms, latency %d intervals, timeout %d ms", interval*1.25, latency, timeout*10);
    is_update_param = true;
}

void phy_updated(struct bt_conn *conn, struct bt_conn_le_phy_info *param)
{
    if (param->tx_phy == BT_CONN_LE_TX_POWER_PHY_1M) {
        LOG_INF("PHY updated. New PHY: 1M");
    }
    else if (param->tx_phy == BT_CONN_LE_TX_POWER_PHY_2M) {
        LOG_INF("PHY updated. New PHY: 2M");
    }
    else if (param->tx_phy == BT_CONN_LE_TX_POWER_PHY_CODED_S8) {
        LOG_INF("PHY updated. New PHY: Long Range");
    }
    is_update_PHY = true;
}

void security_changed(struct bt_conn *conn, bt_security_t level,enum bt_security_err err)
{
    char addr[BT_ADDR_LE_STR_LEN];
    bt_addr_le_to_str(bt_conn_get_dst(conn), addr, sizeof(addr));
    if (!err) LOG_INF("Security changed: %s level %u\n", addr, level);
    else LOG_INF("Security failed: %s level %u err %d\n", addr, level, err);
}

struct bt_conn_cb connection_cb = {
    .connected              = connected,
    .disconnected           = disconnected,
    .le_param_updated       = param_updated,
    .le_phy_updated         = phy_updated,
    .security_changed       = security_changed
};

// AUTHENTUCATION AND PAIRING ------------------------------------------------------------------------------------------------------------------------

static void auth_passkey_display(struct bt_conn *conn, unsigned int passkey)
{
	char addr[BT_ADDR_LE_STR_LEN];
	bt_addr_le_to_str(bt_conn_get_dst(conn), addr, sizeof(addr));
	LOG_INF("Passkey for %s: %06u\n", addr, passkey);
}

static void auth_cancel(struct bt_conn *conn)
{
	char addr[BT_ADDR_LE_STR_LEN];
	bt_addr_le_to_str(bt_conn_get_dst(conn), addr, sizeof(addr));
	LOG_INF("Pairing cancelled: %s\n", addr);
}

static struct bt_conn_auth_cb conn_auth_callbacks = {
	.passkey_display    = auth_passkey_display,
	.cancel             = auth_cancel,
};

static void pairing_complete (struct bt_conn *conn, bool bonded)
{
    char addr[BT_ADDR_LE_STR_LEN];
	bt_addr_le_to_str(bt_conn_get_dst(conn), addr, sizeof(addr));
	LOG_INF("Pairing complete: %s\n", addr);
    
    /*int err = bt_unpair(BT_ID_DEFAULT,BT_ADDR_LE_ANY);
	if (err) LOG_INF("Cannot delete bond (err: %d)\n", err);
	else LOG_INF("Bond deleted succesfully \n");*/
}

static void pairing_failed (struct bt_conn *conn, enum bt_security_err reason)
{
    char addr[BT_ADDR_LE_STR_LEN];
	bt_addr_le_to_str(bt_conn_get_dst(conn), addr, sizeof(addr));
	LOG_INF("Pairing failed: %s , reason: %d\n", addr, reason);
}

static struct bt_conn_auth_info_cb conn_auth_info_callbacks = {
    .pairing_complete   = pairing_complete,
    .pairing_failed     = pairing_failed,
};

// FUNCTIONS GET ------------------------------------------------------------------------------------------------------------------------

bool get_BLE_state_conn()
{
    return app_notifi_conn;
}

bool get_BLE_state_adv()
{
    return app_notifi_adv;
}

bool get_BEL_state_error()
{
    return app_notifi_error;
}

// MACHINE ------------------------------------------------------------------------------------------------------------------------

void ble_machine()
{
    uint8_t err;
    switch (ble_machine_state)
    {
        case BLE_CB_REGISTERS:
        {	
            err = bt_conn_auth_cb_register(&conn_auth_callbacks);
            if (err) {
                LOG_INF("Failed to register authorization callbacks.\n");
                return;
            }

            err = bt_conn_auth_info_cb_register(&conn_auth_info_callbacks);
            if (err) {
                LOG_INF("Failed to register authorization info callbacks.\n");
                return;
            }

            bt_conn_cb_register(&connection_cb);

            ble_machine_state = BLE_INIT;
        }

        case BLE_INIT:
        {
            err = bt_enable(NULL);                                          // Habilita e inicializa la pila BLE
	        if (err) {
		        LOG_ERR("BLE Bluetooth init failed. Error: %d\n", err);
				app_notifi_error = true;
		        return;
	        }

            // Rever el funcionamiento de ese bloque FRAN
            bt_addr_le_t perypheral_addr;                                   // Variable para almacenar mi direccion BLE
            err = bt_addr_le_create_static(&perypheral_addr);               // Creacion de una BLE random static address
            if(err) {
                LOG_ERR("BLE addr create failed, Error: %d\n", err);
                app_notifi_error = true;
            } else {
                if(bt_id_create(&perypheral_addr,NULL) < 0) {               // Agregamos la direccion
                    LOG_ERR("BLE addr add failed, Error: %d\n", err);
                    app_notifi_error = true;
                }
            }
            char addr[BT_ADDR_LE_STR_LEN];
            bt_addr_le_to_str(&perypheral_addr, addr, sizeof(addr));
            LOG_INF("Perypheral addr: %s\n",addr);

            bt_passkey_set(PASSKEY);                                        // Configuro manualmente y de forma NO aleatoria la passkey

		    settings_load();                                                // Carga la configuracion de BLE almacenada en memoria flash

			app_notifi_error = false;
            LOG_INF("BLE inicializado\n");
            ble_machine_state = BLE_ADVERTISING;
            break;
        }

        case BLE_ADVERTISING:
        {
	        advertising_start();
            ble_machine_state = BLE_WAITING_CONECTION;
            break;
        }

        case BLE_WAITING_CONECTION:
        {
            if(is_update_param && is_update_PHY){
                ble_machine_state = BLE_READY;
            }
            break;
        }

        case BLE_UPDATE_CONN_PARAM:
        {
            int err;
            struct bt_le_conn_param *conn_param = BT_LE_CONN_PARAM(CONN_MIN_INTERVAL,CONN_MAN_INTERVAL,CONN_LATENCY,CONN_TIMEOUT);
            err = bt_conn_le_param_update(current_conn,conn_param);
            if(err){
                LOG_ERR("BLE update param failed, Error: %d\n", err);
                app_notifi_error = true;
            }

            const struct bt_conn_le_phy_param preferred_phy = {
                .options = BT_CONN_LE_PHY_OPT_NONE,
                .pref_rx_phy = BT_GAP_LE_PHY_2M,
                .pref_tx_phy = BT_GAP_LE_PHY_2M,
            };
            err = bt_conn_le_phy_update(current_conn, &preferred_phy);
            if (err) {
                LOG_ERR("bt_conn_le_phy_update() returned %d", err);
                app_notifi_error = true;
            }

            //Aca podria agrandar el tamaño de la UART L3E3 punto 9 FRAN

            ble_machine_state = BLE_WAITING_CONECTION;
            break;
        }

        case BLE_READY:
        {
            LOG_INF("BLE ready");
            ble_machine_state = BLE_WAITING;
        }

        case BLE_WAITING:
        {
            break;
        }
		
    }
}
```

## src/ble_machine.h
```c
#ifndef BLE_MACHINE_H
#define BLE_MACHINE_H

// INCLUDES ------------------------------------------------------------------------------------------------------------------------

#include <zephyr/bluetooth/bluetooth.h>         // Incluye definiciones, macros y las funciones principales de la pila BLE como bt_enable, bt_le_adv_start. 
#include <zephyr/bluetooth/gap.h>               // Incluye las definiciones de las opciones disponiple para la etapa del advertisign
#include <zephyr/bluetooth/uuid.h>              // Permite el manejo de las UUID de servicios
#include <zephyr/bluetooth/addr.h>              // Permite administrar las direcciones BLE
#include <zephyr/bluetooth/conn.h>              // Permite el manejo de la conexión BLE
#include <zephyr/settings/settings.h>           // Permite almacenar y restaurar la configuración Y el estado de Bluetooth (Ej: claves de emparejamiento) de forma persistente en la memoria flash

#include "dmq_nus_service.h"                    // Incluye las funciones y definiciones particulares del servicio NUS utilizando el codigo modificado
#include "app_config.h"

// DEFINITIONS ------------------------------------------------------------------------------------------------------------------------

enum ble_machine
{
    BLE_CB_REGISTERS,
    BLE_INIT,
    BLE_ADVERTISING,
    BLE_WAITING_CONECTION,
    BLE_CONECCTED,
    BLE_WAITING_TO_SEND,
    KEY_REPORT_SENT,
    BLE_WAITING_SEND,
    BLE_CLEAR_KEY,
    BLE_DEACTIVATE,

    BLE_WAITING,
    BLE_READY,
    BLE_UPDATE_CONN_PARAM
};

// FUNCTIONS ------------------------------------------------------------------------------------------------------------------------

void advertising_start();

void connected(struct bt_conn *conn, uint8_t err);
void disconnected(struct bt_conn *conn, uint8_t reason);
void param_updated(struct bt_conn *conn, uint16_t interval, uint16_t latency, uint16_t timeout);
void phy_updated(struct bt_conn *conn, struct bt_conn_le_phy_info *param);
void security_changed(struct bt_conn *conn, bt_security_t level,enum bt_security_err err);

bool get_BLE_state_conn();
bool get_BLE_state_adv();
bool get_BEL_state_error();

void ble_machine();

// ------------------------------------------------------------------------------------------------------------------------

#endif//BLE_MACHINE_H
```

## src/dmq_nus_service.c
```c
// INCLUDES ------------------------------------------------------------------------------------------------------------------------

#include "dmq_nus_service.h"

// VARIABLES ------------------------------------------------------------------------------------------------------------------------

LOG_MODULE_REGISTER(LOG_NUS, LOG_NUS_LEVEL);

static nus_cb_t nus_cb;

// CALLBACKS ------------------------------------------------------------------------------------------------------------------------

static void nus_ccc_cfg_changed(const struct bt_gatt_attr *attr, uint16_t value)
{
	if (nus_cb.send_enabled) {
		LOG_DBG("Notification has been turned %s", ( value == BT_GATT_CCC_NOTIFY ? "ON" : "OFF") );
		nus_cb.send_enabled(value == BT_GATT_CCC_NOTIFY ? true : false);
	}
}

static ssize_t on_receive(struct bt_conn *conn, const struct bt_gatt_attr *attr,
			  			  const void *buf, uint16_t len, uint16_t offset, uint8_t flags)
{
	LOG_DBG("Received data, handle %d, conn %p", attr->handle, (void *)conn);

	if (nus_cb.received) nus_cb.received(conn, buf, len);

	return len;
}

static void on_sent(struct bt_conn *conn, void *user_data)
{
	ARG_UNUSED(user_data);

	LOG_DBG("Data send, conn %p", (void *)conn);

	if (nus_cb.sent) nus_cb.sent(conn);
}

// ATTRIBUTE TABLE ------------------------------------------------------------------------------------------------------------------------

BT_GATT_SERVICE_DEFINE( nus_svc,											// Declaracion del servicio NUS
	BT_GATT_PRIMARY_SERVICE( BT_UUID_NUS_SERVICE),							// Declaracion de la caracteristica que marca el inicio del servicio primario 
	
	BT_GATT_CHARACTERISTIC(	BT_UUID_NUS_TX,									// Declaramos la caracteristica de valor TX y le asignamos su UUID
			       			BT_GATT_CHRC_NOTIFY,								// Idicamos que permite la operacion de notificacion 
							BT_GATT_PERM_READ_AUTHEN,							// Permite la lectura solo con autenticacion
			       			NULL, NULL, 										// Las callback de lectura y escritura no se utilizan
							NULL),												// Datos de usuario del atributo característico.
	
	BT_GATT_CCC( nus_ccc_cfg_changed,										// Esta caracteristica permite configurar la notificacion de la caracteristica TX
				 BT_GATT_PERM_READ_AUTHEN | 									// Permite la lectura con autenticacion
				 BT_GATT_PERM_WRITE_AUTHEN),									// Permite la escritura con autenticacion
	
	BT_GATT_CHARACTERISTIC( BT_UUID_NUS_RX,									// Declaramos la caracteristica de valor RX y le asignamos su UUID
			       			BT_GATT_CHRC_WRITE |								// Operaciones permitidas:	Escritura  
			       			BT_GATT_CHRC_WRITE_WITHOUT_RESP,					// 							Escritura sin confirmacion 
					        BT_GATT_PERM_READ_AUTHEN | 							// Permisos: Lectura con autenticacion
			       			BT_GATT_PERM_WRITE_AUTHEN,							// 			 Escritura con autenticacion
							NULL, on_receive, 									// Configuramos la calback de lectura Y escritura respectivamente
							NULL),												// Datos de usuario del atributo característico.

);

// FUNCTIONS ------------------------------------------------------------------------------------------------------------------------

int bt_nus_init(nus_cb_t *callbacks)
{
	if (callbacks) {
		nus_cb.received = callbacks->received;
		nus_cb.sent = callbacks->sent;
		nus_cb.send_enabled = callbacks->send_enabled;
	}
	return 0;
}

int bt_nus_send(struct bt_conn *conn, const uint8_t *data, uint16_t len)
{
	//const struct bt_gatt_attr *attr = &nus_svc.attrs[2];	// Para borrar
	struct bt_gatt_notify_params params = {0};									// Estructura de parametros necesarios para la notificacion

	params.attr = &nus_svc.attrs[2];											// Puntero al atributo de la característica	(Esto puede ser remplazado por &nus_svc.attrs[1] o por )
	params.data = data;															// Puntero tipo void a la informacion a enviar			
	params.len 	= len;															// Largo en bytes de la informacion
	params.func = on_sent;														// Callback de tipo bt_gatt_complete_func_t para confirmar la notificiacion

	if (!conn) return bt_gatt_notify_cb(NULL, &params);							// Si no se expecifico una conexion se notifica a todas las existentes					
	else if (bt_gatt_is_subscribed(conn, params.attr, BT_GATT_CCC_NOTIFY)) {	// Verificaremos manualmente si el cliente tiene habilitada la notificación en esa conexión
		return bt_gatt_notify_cb(conn, &params);								// Si el cliente tiene habilitada la notificacion se le envia una
	}
	else return -EINVAL;
}

uint32_t bt_nus_get_mtu(struct bt_conn *conn)
{
	// According to 3.4.7.1 Handle Value Notification off the ATT protocol. Maximum supported notification is ATT_MTU - 3 */
	return bt_gatt_get_mtu(conn) - 3;											// Devuelve la longitud máxima de datos que se puede enviar con bt_nus_send.
}
```

## src/dmq_nus_service.h
```c
#ifndef BT_NUS_H
#define BT_NUS_H

// INCLUDES ------------------------------------------------------------------------------------------------------------------------

#include <zephyr/bluetooth/conn.h>
#include <zephyr/bluetooth/uuid.h>
#include <zephyr/bluetooth/gatt.h>

#include "app_config.h"

// UUID ------------------------------------------------------------------------------------------------------------------------

#define BT_UUID_NUS_VAL 		BT_UUID_128_ENCODE(0x6e400001, 0xb5a3, 0xf393, 0xe0a9, 0xe50e24dcca9e)	// UUID del servicio NUS
#define BT_UUID_NUS_RX_VAL 		BT_UUID_128_ENCODE(0x6e400002, 0xb5a3, 0xf393, 0xe0a9, 0xe50e24dcca9e)	// UUID de la caracteristica RX
#define BT_UUID_NUS_TX_VAL 		BT_UUID_128_ENCODE(0x6e400003, 0xb5a3, 0xf393, 0xe0a9, 0xe50e24dcca9e)	// UUID de la caracteristica TX

#define BT_UUID_NUS_SERVICE   	BT_UUID_DECLARE_128(BT_UUID_NUS_VAL)
#define BT_UUID_NUS_RX        	BT_UUID_DECLARE_128(BT_UUID_NUS_RX_VAL)
#define BT_UUID_NUS_TX        	BT_UUID_DECLARE_128(BT_UUID_NUS_TX_VAL)

// VARIABLES ------------------------------------------------------------------------------------------------------------------------

typedef struct {
	void (*received)(struct bt_conn *conn, const uint8_t *const data, uint16_t len); 	// Callback para notificar la recepcion de informacion.

	void (*sent)(struct bt_conn *conn);													// Callback para confirmar el envio de la informacion.

	void (*send_enabled)(bool status);								// Callback para notificar el estado de habilitacion del envio de informacion
}nus_cb_t;

// FUNCIONES ------------------------------------------------------------------------------------------------------------------------

int bt_nus_init(nus_cb_t *callbacks);

int bt_nus_send(struct bt_conn *conn, const uint8_t *data, uint16_t len);

uint32_t bt_nus_get_mtu(struct bt_conn *conn);

// ------------------------------------------------------------------------------------------------------------------------

#endif//BT_NUS_H
```

## src/uart_machine.c
```c
// INCLUDES ------------------------------------------------------------------------------------------------------------------------

#include "uart_machine.h"

// VARIABLES ------------------------------------------------------------------------------------------------------------------------

LOG_MODULE_REGISTER(LOG_UART, LOG_UART_LEVEL);

static uint8_t uart_machine_state       = UART_INIT;

static bool app_notifi_error            = false;
static bool app_notifi_ready            = false;

static uint8_t current_buffer_index     = 0;
static uint16_t uart_data_index         = 0;
static uint16_t app_data_index          = 0;
static uint16_t serch_data_index        = 0;

const struct device *uart = DEVICE_DT_GET(DT_NODELABEL(uart1));

const struct uart_config uart_config = {.baudrate   = UART_BAUDRATE,
		                                .parity     = UART_PARITY,
		                                .stop_bits  = UART_STOP_BITS ,
		                                .data_bits  = UART_DATA_BITS ,
		                                .flow_ctrl  = UART_FLOW_CTRL };

uint8_t uart_rx_buffers[RECEIVE_BUFF_NUMBER][RECEIVE_BUFF_SIZE];

// FUNCTIONS GET ------------------------------------------------------------------------------------------------------------------------

bool get_UART_notifi_error(void)
{
    return app_notifi_error;
}

bool get_UART_notifi_ready(void)
{
    return app_notifi_ready;
}

uint8_t get_rdy_data()
{
    uint8_t data;
    if(app_data_index != uart_data_index)
    {
        if( ((app_data_index+LEN_CODE)%(RECEIVE_BUFF_NUMBER*RECEIVE_BUFF_SIZE)) <= serch_data_index)
        {
            data = * ( *((uint8_t (*)[RECEIVE_BUFF_NUMBER*RECEIVE_BUFF_SIZE])uart_rx_buffers) + app_data_index);
            app_data_index ++;
            app_data_index %= (RECEIVE_BUFF_NUMBER*RECEIVE_BUFF_SIZE);
            
            //LOG_DBG("UART get_rdy_data : uart index = %d - app index = %d - caracter = %c\n", uart_data_index, app_data_index, data);
            return data;
        }
    }
    return 0;
}

// FUNCTIONS ------------------------------------------------------------------------------------------------------------------------

/*void serch_code(Code_callback_t cb)
{
    uint8_t data;
    static uint8_t last_data;
    static uint8_t code[LEN_CODE]   = CODE;
    static uint8_t counter          = 0;
    static bool    flag_code        = false;
    static uint8_t len_code         = 0;
    static uint8_t code_index       = 0;
    
    while(serch_data_index != uart_data_index)
    {
        data = * ( *((uint8_t (*)[RECEIVE_BUFF_NUMBER*RECEIVE_BUFF_SIZE])uart_rx_buffers) + serch_data_index);
        serch_data_index ++;
        serch_data_index %= (RECEIVE_BUFF_NUMBER*RECEIVE_BUFF_SIZE);
        if(flag_code == true)
        {
            if(len_code == 0) len_code = data;
            else {
                counter ++;
                if(counter == len_code)
                {
                    cb(serch_data_index, ((uint8_t (*)[RECEIVE_BUFF_NUMBER*RECEIVE_BUFF_SIZE])uart_rx_buffers) ,data);
                    flag_code = false;
                    counter   = 0;
                    len_code  = 0;
                }
            }
            return;
        }
        if(data == code[counter]) counter++;
        else counter = 0;
        if(counter == LEN_CODE-1) {
            flag_code = true; 
            counter   = 0;
            len_code  = 0;
        }
    }
}*/

// CALLBACK ------------------------------------------------------------------------------------------------------------------------

static void uart_cb(const struct device *dev, struct uart_event *evt, void *user_data)
{
	switch (evt->type) 
	{
        case UART_RX_BUF_REQUEST:
        {
            LOG_DBG("UART_RX_BUF_REQUEST\n");
            uart_rx_buf_rsp(uart,
                            uart_rx_buffers[(current_buffer_index+1)%RECEIVE_BUFF_NUMBER],
                            RECEIVE_BUFF_SIZE);
            break;
        }

		case UART_RX_RDY:
		{
            LOG_DBG("UART_RX_RDY\n");
            uart_data_index = uart_data_index + evt->data.rx.len;
            uart_data_index %= (RECEIVE_BUFF_NUMBER*RECEIVE_BUFF_SIZE);
			break;
		}

        case UART_RX_BUF_RELEASED:
        {
            LOG_DBG("UART_RX_BUF_RELEASED\n");
            current_buffer_index ++;
            current_buffer_index %= RECEIVE_BUFF_NUMBER;
            break;
        }

		case UART_RX_DISABLED:
		{
            LOG_DBG("UART_RX_DISABLED\n");
            //uart_machine_state = WAIT_FOT_REINIT;   // FRAN usar esto aca traia problemas pero no me acuerdo por que
            app_notifi_error = true;
            break;
		}

        case UART_RX_STOPPED:
        {
            LOG_ERR("UART_RX_STOP: ");
            app_notifi_error = true;
            switch (evt->data.rx_stop.reason)
            {
                case UART_ERROR_OVERRUN:
                    LOG_ERR("OVERRUN\n");
                    break;
            
                case UART_ERROR_PARITY:
                    LOG_ERR("PARITY\n");
                    break;

                case UART_ERROR_FRAMING:
                    LOG_ERR("FRAMING\n");
                    break;

                case UART_BREAK:
                    LOG_ERR("BREAK\n");
                    break;

                case UART_ERROR_COLLISION:
                    LOG_ERR("COLLISION\n");
                    break;

                case UART_ERROR_NOISE:
                    LOG_ERR("NOISE\n");
                    break;
            }
            break;
        }

		default:
		{
			LOG_DBG("Default - Event: %d\n" , evt->type);
			break;
		}
	}
}

// FUNCTIONS MACHINE ------------------------------------------------------------------------------------------------------------------------

void uart_machine()
{
    uint8_t err;

    switch (uart_machine_state)
    {
        case UART_INIT:
        {
            if (!device_is_ready(uart)) {
		        LOG_ERR("UART device is not ready\n");
                app_notifi_error = true;
                uart_machine_state = UART_DEACTIVATE;
		        break;
	        }

	        err = uart_configure(uart, &uart_config);
	        if (err == -ENOSYS) {
		        LOG_ERR("Init UART failed\n");
                app_notifi_error = true;
                uart_machine_state = UART_DEACTIVATE;
		        break;
	        }

	        err = uart_callback_set(uart, uart_cb, NULL);
	        if (err) {
		        LOG_ERR("Set UART Callback failed\n");
                app_notifi_error = true;
                uart_machine_state = UART_DEACTIVATE;
		        break;
	        }

            uart_machine_state = UART_RX_INIT;
            break;
        }

        case UART_RX_INIT:
        {
            current_buffer_index = 0;
            uart_data_index      = 0;
            app_data_index       = 0;
            serch_data_index     = 0;

            if (uart_rx_enable(uart ,uart_rx_buffers[current_buffer_index] ,RECEIVE_BUFF_SIZE ,RECEIVE_TIMEOUT_HAR_US)) {
		        LOG_ERR("UART RX enabled failed\n");
                app_notifi_error = true;
                uart_machine_state = UART_DEACTIVATE;
                break;
	        }

            LOG_INF("UART STATE WORKING\n");
            uart_machine_state = UART_WORKING;
            app_notifi_ready = true;
            break;
        }
    
        case UART_WORKING:
        {
            
            break;
        }

        case UART_DEACTIVATE:     //FRAN
        {
            LOG_INF("UART_DEACTIVATE\n");
            uart_rx_disable(uart);
            uart_machine_state = UART_INIT;
            app_notifi_ready   = false;
            break;
        }

        case WAIT_FOT_REINIT:     //FRAN
        {
            LOG_INF("UART WAIT_FOT_REINIT\n");
            k_sleep(K_MSEC(K_INTERVAL_TO_REINIT));
            uart_machine_state = UART_INIT;
            app_notifi_ready   = false;
            break;
        }

        default:
        {
            LOG_ERR("UART machine state default\n");
            uart_machine_state = UART_DEACTIVATE;
            break;
        }
    }
}

// ------------------------------------------------------------------------------------------------------------------------
```

## src/uart_machine.h
```c
#ifndef UART_MACHINE_H
#define UART_MACHINE_H

// INCLUDES ------------------------------------------------------------------------------------------------------------------------

#include <zephyr/drivers/uart.h>

#include "app_config.h"

// DEFINITIONS ------------------------------------------------------------------------------------------------------------------------

#define K_INTERVAL_TO_REINIT 50

// VARIABLES ------------------------------------------------------------------------------------------------------------------------

typedef void (*Code_callback_t) (uint16_t index , uint16_t* buf , uint8_t len);

enum uart_machine
{
    NOT_USET,
    UART_INIT,
    UART_RX_INIT,
    UART_WORKING,
    UART_DEACTIVATE,
    WAIT_FOT_REINIT
};

// FUNCTIONS ------------------------------------------------------------------------------------------------------------------------

uint8_t get_rdy_data();
void uart_machine();
bool get_UART_notifi_error(void);
bool get_UART_notifi_ready(void);
// Analiza el buffer en busqueda del codigo, Si lo encuentra envia el largo del codigo y el indice a donde se encuentra.
void serch_code(Code_callback_t cb);

// ------------------------------------------------------------------------------------------------------------------------

#endif//UART_MACHINE_H
```
